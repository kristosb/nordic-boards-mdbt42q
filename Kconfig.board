## Kconfig.board
```kconfig
# Copyright (c) 2023 Nordic Semiconductor ASA
# SPDX-License-Identifier: Apache-2.0

config BOARD_MDBT42Q_NRF52
	bool "mdbt42Q"
	depends on SOC_NRF52832_QFAA
```

## Kconfig.defconfig
```kconfig
# Copyright (c) 2023 Nordic Semiconductor ASA
# SPDX-License-Identifier: Apache-2.0

if BOARD_MDBT42Q_NRF52

config BOARD
	default "mdbt42q_nrf52"

config BT_CTLR
   default BT

endif
```
